#include <Arduino.h>

// ---------------------------------------------------------------------------
// Pin assignments (GPIO numbers, not the FireBeetle 2 silkscreen "D" labels)
// ---------------------------------------------------------------------------
const uint8_t PIN_STEP   = 9;
const uint8_t PIN_DIR    = 13;
const uint8_t PIN_MS1    = 12;
const uint8_t PIN_MS2    = 4;
const uint8_t PIN_MS3    = 21;
const uint8_t PIN_ENABLE = 38;   // A4988 ENABLE is active-LOW
const uint8_t PIN_SENSOR = 47;   // E18-D80NK signal, NPN open-collector, active-LOW

// SLEEP/RESET are hard-wired to VDD on the driver board, not MCU-controlled.

// ---------------------------------------------------------------------------
// Motion parameters
// ---------------------------------------------------------------------------
const int   MOTOR_STEPS_PER_REV = 200;   // NEMA17, 1.8 deg/step
const int   MICROSTEP_DIVISOR   = 8;     // MS1=H, MS2=H, MS3=L -> 1/8 step
const float TARGET_REVS_PER_SEC = 40.0f / 60.0f;  // 40 RPM cruise speed
// const float START_REVS_PER_SEC = 15.0f / 60.0f;  // ramp disabled

const float STEPS_PER_REV = MOTOR_STEPS_PER_REV * MICROSTEP_DIVISOR; // 1600
const float STEPS_PER_SEC = STEPS_PER_REV * TARGET_REVS_PER_SEC;     // ~1067

// A4988 STEP input is edge-triggered, so the pulse is generated by toggling
// the pin: one full step = one LOW->HIGH->LOW cycle = two toggles. Toggling
// every half period at STEPS_PER_SEC therefore yields the correct step rate.
const unsigned long TARGET_STEP_HALF_PERIOD_US =
    (unsigned long)(1000000.0f / (2.0f * STEPS_PER_SEC)); // ~469us

// Ramp-up disabled (screeching/unstable behavior reported) -- running at a
// constant TARGET_STEP_HALF_PERIOD_US instead. Left in place, commented out,
// in case ramping is revisited later.
// const unsigned long START_STEP_HALF_PERIOD_US =
//     (unsigned long)(1000000.0f / (2.0f * STEPS_PER_REV * START_REVS_PER_SEC)); // ~1250us

const float SWING_DEGREES = 360.0f;
// 360 degrees, in microsteps
const long STEPS_PER_SWING = (long)(STEPS_PER_REV * SWING_DEGREES / 360.0f); // 1600

// const float RAMP_DEGREES = 90.0f;
// const long RAMP_STEPS = (long)(STEPS_PER_REV * RAMP_DEGREES / 360.0f); // 400

// Sensor debounce window: the raw reading must stay stable for this long
// before a HIGH->LOW transition counts as a real trigger.
const unsigned long SENSOR_DEBOUNCE_MS = 40;

const bool DIR_CW  = HIGH;
const bool DIR_CCW = LOW;

// ---------------------------------------------------------------------------
// State
// ---------------------------------------------------------------------------
unsigned long lastToggleMicros = 0;
// unsigned long currentStepHalfPeriodUs = START_STEP_HALF_PERIOD_US; // ramp disabled
bool stepPinState = LOW;
bool dirState = DIR_CW; // current commanded direction
bool motorRunning = false; // sensor acts as an on/off toggle for this
long stepsTakenInLeg = 0;  // microsteps completed since the last reversal (or motor-on)

bool sensorRawLast = HIGH;       // last raw digitalRead(), used to spot changes
bool sensorStable = HIGH;        // debounced sensor state
unsigned long lastSensorEdgeMillis = 0;

void setup() {
  Serial.begin(115200);

  // This board's USB port is the ESP32-S3's native USB CDC, not a UART
  // bridge chip. Serial.begin() returns immediately even though the host
  // is still re-enumerating the port after reset, so printing right away
  // silently drops the boot banner. Serial evaluates false until a host
  // actually opens the port (DTR asserted); wait for that, but cap it so
  // the motor still starts even if no monitor is ever connected.
  unsigned long usbWaitStart = millis();
  while (!Serial && (millis() - usbWaitStart) < 5000) {
    delay(10);
  }

  pinMode(PIN_STEP, OUTPUT);
  pinMode(PIN_DIR, OUTPUT);
  pinMode(PIN_MS1, OUTPUT);
  pinMode(PIN_MS2, OUTPUT);
  pinMode(PIN_MS3, OUTPUT);
  pinMode(PIN_ENABLE, OUTPUT);
  pinMode(PIN_SENSOR, INPUT_PULLUP); // sensor is open-collector; pull-up needed

  // Microstep select: 1/8 step (MS1=H, MS2=H, MS3=L per A4988 datasheet)
  digitalWrite(PIN_MS1, HIGH);
  digitalWrite(PIN_MS2, HIGH);
  digitalWrite(PIN_MS3, LOW);

  // Idle at startup; the sensor toggles motorRunning on/off
  digitalWrite(PIN_DIR, dirState);

  // Seed the debounce state from the sensor's actual level at boot, so a
  // sensor that's already blocked at startup doesn't register a fake trigger
  sensorRawLast = digitalRead(PIN_SENSOR);
  sensorStable = sensorRawLast;

  digitalWrite(PIN_STEP, LOW);

  // Enable the driver last, once direction/microstep are already set
  digitalWrite(PIN_ENABLE, LOW); // active-LOW: LOW = enabled

  Serial.println();
  Serial.println("=== A4988 NEMA17 bring-up ===");
  Serial.println("Pins configured as OUTPUT: STEP=9 DIR=13 MS1=12 MS2=4 MS3=21 ENABLE=38");
  Serial.println("Microstepping: 1/8 step (MS1=H, MS2=H, MS3=L)");
  Serial.println("Driver ENABLE: LOW (enabled)");
  Serial.println("Sensor: E18-D80NK on GPIO47, INPUT_PULLUP, active-LOW");
  Serial.println("Motion: idle at startup; sensor toggles continuous 360 CW / 360 CCW oscillation on/off");
  Serial.print("Cruise speed: ");
  Serial.print(TARGET_REVS_PER_SEC * 60.0f);
  Serial.print(" RPM (");
  Serial.print(TARGET_STEP_HALF_PERIOD_US);
  Serial.println(" us half-period)");
  // Ramp-up disabled -- running at a constant cruise speed instead.
  // Serial.print("Ramp-up: starts at ");
  // Serial.print(START_REVS_PER_SEC * 60.0f);
  // Serial.print(" RPM (");
  // Serial.print(START_STEP_HALF_PERIOD_US);
  // Serial.print(" us), reaches cruise speed after ");
  // Serial.print(RAMP_DEGREES);
  // Serial.println(" degrees of each leg");

  lastToggleMicros = micros();
}

void checkSensorTrigger() {
  bool sensorRaw = digitalRead(PIN_SENSOR);
  unsigned long nowMs = millis();

  // Any raw change restarts the debounce window
  if (sensorRaw != sensorRawLast) {
    sensorRawLast = sensorRaw;
    lastSensorEdgeMillis = nowMs;
  }

  // Once the raw reading has held steady for the debounce window, accept it
  // as the new stable state. Only a HIGH->LOW transition of the *stable*
  // state counts as a trigger.
  if ((nowMs - lastSensorEdgeMillis) >= SENSOR_DEBOUNCE_MS && sensorRaw != sensorStable) {
    bool previousStable = sensorStable;
    sensorStable = sensorRaw;

    if (previousStable == HIGH && sensorStable == LOW) {
      // Sensor acts as an on/off toggle
      motorRunning = !motorRunning;
      if (motorRunning) {
        dirState = DIR_CW;
        digitalWrite(PIN_DIR, dirState);
        stepsTakenInLeg = 0;
        // currentStepHalfPeriodUs = START_STEP_HALF_PERIOD_US; // ramp disabled
        Serial.println("Sensor triggered. Motor ON: oscillating 360 CW / 360 CCW.");
      } else {
        stepPinState = LOW;
        digitalWrite(PIN_STEP, LOW);
        Serial.println("Sensor triggered. Motor OFF.");
      }
    }
  }
}

void loop() {
  checkSensorTrigger();

  if (!motorRunning) {
    return; // off: no STEP pulses until the next trigger
  }

  // Non-blocking square-wave generation on STEP: no delay(), so this loop
  // stays free to grow (position control, etc.) later. Ramp-up is disabled
  // for now -- runs at a constant TARGET_STEP_HALF_PERIOD_US.
  unsigned long now = micros();
  if (now - lastToggleMicros >= TARGET_STEP_HALF_PERIOD_US) {
    lastToggleMicros = now;
    stepPinState = !stepPinState;
    digitalWrite(PIN_STEP, stepPinState);

    // A4988 steps on the rising edge, so a LOW->HIGH transition is one
    // completed microstep. Every 360 degrees, reverse and keep going --
    // this repeats indefinitely until the sensor toggles the motor off.
    if (stepPinState == HIGH) {
      stepsTakenInLeg++;

      if (stepsTakenInLeg >= STEPS_PER_SWING) {
        dirState = (dirState == DIR_CW) ? DIR_CCW : DIR_CW;
        digitalWrite(PIN_DIR, dirState);
        stepsTakenInLeg = 0;
        Serial.print("Reached 360 degrees. Reversing to: ");
        Serial.println(dirState == DIR_CW ? "CW" : "CCW");
      }

      // --- Ramp-up disabled (screeching/unstable behavior reported) ---
      // if (stepsTakenInLeg < RAMP_STEPS) {
      //   float rampFraction = (float)stepsTakenInLeg / (float)RAMP_STEPS;
      //   currentStepHalfPeriodUs = START_STEP_HALF_PERIOD_US -
      //       (unsigned long)((START_STEP_HALF_PERIOD_US - TARGET_STEP_HALF_PERIOD_US) * rampFraction);
      // } else {
      //   currentStepHalfPeriodUs = TARGET_STEP_HALF_PERIOD_US;
      // }
    }
  }
}
