#include <Arduino.h>

// ---------------------------------------------------------------------------
// Pin assignments (GPIO numbers, not the FireBeetle 2 silkscreen "D" labels)
// ---------------------------------------------------------------------------
const uint8_t PIN_STEP       = 8;
const uint8_t PIN_DIR        = 14;
const uint8_t PIN_MS1        = 1;
const uint8_t PIN_MS2        = 18;
const uint8_t PIN_MS3        = 6;
const uint8_t PIN_ENABLE     = 7;   // A4988 ENABLE is active-LOW
const uint8_t PIN_LIMIT_HOME = 20;  // limit switch, motor/home side of the rail (SCL header pin)
const uint8_t PIN_LIMIT_IDLE = 19;  // limit switch, idler side of the rail (SDA header pin)
const uint8_t PIN_HEARTBEAT  = LED_BUILTIN; // GPIO15 onboard LED, blinks while loop() runs

// NOTE: GPIO15 (silkscreen D13) is this board's onboard LED. Don't use it for
// a limit switch input -- the LED loads the weak internal pull-up so the pin
// never reads a clean HIGH. It's used as a heartbeat indicator instead.

// SLEEP/RESET are hard-wired to VDD on the driver board, not MCU-controlled.
//
// Limit switches are SPDT, wired NC + C (NO left unconnected) for fail-safe
// behavior: C -> GND, NC -> this GPIO with INPUT_PULLUP. Resting (untriggered)
// reads LOW; a pressed lever, or a wire falling off, reads HIGH.

// ---------------------------------------------------------------------------
// Motion parameters
// ---------------------------------------------------------------------------
const int   MOTOR_STEPS_PER_REV = 200;   // NEMA17, 1.8 deg/step
const int   MICROSTEP_DIVISOR   = 8;     // MS1=H, MS2=H, MS3=L -> 1/8 step
const float TARGET_REVS_PER_SEC = 35.0f / 60.0f;  // 40 RPM cruise speed

const float STEPS_PER_REV = MOTOR_STEPS_PER_REV * MICROSTEP_DIVISOR; // 1600
const float STEPS_PER_SEC = STEPS_PER_REV * TARGET_REVS_PER_SEC;     // ~1067

// A4988 STEP input is edge-triggered, so the pulse is generated by toggling
// the pin: one full step = one LOW->HIGH->LOW cycle = two toggles. Toggling
// every half period at STEPS_PER_SEC therefore yields the correct step rate.
const unsigned long TARGET_STEP_HALF_PERIOD_US =
    (unsigned long)(1000000.0f / (2.0f * STEPS_PER_SEC)); // ~469us

// Limit switch debounce window: a raw reading must hold steady for this long
// before it counts as the new stable state. These are mechanical snap-action
// switches and can bounce for a few ms on contact.
const unsigned long SWITCH_DEBOUNCE_MS = 40;

// Heartbeat LED toggle interval -- proves the firmware is running even when
// no serial monitor is attached.
const unsigned long HEARTBEAT_MS = 500;

// Verified on this rig: DIR=LOW spins the motor clockwise, which carries the
// carriage toward LIMIT_HOME. Swap these two values if the wiring changes.
const bool DIR_TOWARD_HOME = LOW;
const bool DIR_TOWARD_IDLE = HIGH;

// ---------------------------------------------------------------------------
// Debounced limit switch state
// ---------------------------------------------------------------------------
struct LimitSwitch {
  uint8_t pin;
  bool rawLast;
  bool stable;
  unsigned long lastEdgeMillis;
};

LimitSwitch limitHome = { PIN_LIMIT_HOME, LOW, LOW, 0 };
LimitSwitch limitIdle = { PIN_LIMIT_IDLE, LOW, LOW, 0 };

// Returns true on the exact tick a switch's debounced state goes LOW->HIGH
// (i.e. it just triggered). Called every loop() iteration for both switches.
bool debouncedTrigger(LimitSwitch &sw) {
  bool raw = digitalRead(sw.pin);
  unsigned long nowMs = millis();

  if (raw != sw.rawLast) {
    sw.rawLast = raw;
    sw.lastEdgeMillis = nowMs;
  }

  if ((nowMs - sw.lastEdgeMillis) >= SWITCH_DEBOUNCE_MS && raw != sw.stable) {
    bool previousStable = sw.stable;
    sw.stable = raw;
    if (previousStable == LOW && sw.stable == HIGH) {
      return true;
    }
  }
  return false;
}

// ---------------------------------------------------------------------------
// State
// ---------------------------------------------------------------------------
unsigned long lastToggleMicros = 0;
bool stepPinState = LOW;
bool dirState = DIR_TOWARD_HOME; // current commanded direction
bool motionHalted = false;       // true only if both limits are triggered at boot
unsigned long lastHeartbeatMillis = 0;
bool heartbeatState = LOW;

void setup() {
  Serial.begin(115200);

  // This board's USB port is the ESP32-C6's native USB CDC, not a UART
  // bridge chip. Serial.begin() returns immediately even though the host
  // is still re-enumerating the port after reset, so printing right away
  // silently drops the boot banner. Serial evaluates false until a host
  // actually opens the port (DTR asserted); wait for that, but cap it so
  // the motor still starts even if no monitor is ever connected.
  unsigned long usbWaitStart = millis();
  while (!Serial && (millis() - usbWaitStart) < 5000) {
    delay(10);
  }

  pinMode(PIN_STEP, OUTPUT);
  pinMode(PIN_DIR, OUTPUT);
  pinMode(PIN_MS1, OUTPUT);
  pinMode(PIN_MS2, OUTPUT);
  pinMode(PIN_MS3, OUTPUT);
  pinMode(PIN_ENABLE, OUTPUT);
  pinMode(PIN_LIMIT_HOME, INPUT_PULLUP);
  pinMode(PIN_LIMIT_IDLE, INPUT_PULLUP);
  pinMode(PIN_HEARTBEAT, OUTPUT);
  digitalWrite(PIN_HEARTBEAT, LOW);

  // Microstep select: 1/8 step (MS1=H, MS2=H, MS3=L per A4988 datasheet)
  digitalWrite(PIN_MS1, HIGH);
  digitalWrite(PIN_MS2, HIGH);
  digitalWrite(PIN_MS3, LOW);

  // Seed the debounce state from each switch's actual level at boot, so an
  // already-triggered switch doesn't register a fake edge on the first read.
  limitHome.rawLast = digitalRead(PIN_LIMIT_HOME);
  limitHome.stable = limitHome.rawLast;
  limitIdle.rawLast = digitalRead(PIN_LIMIT_IDLE);
  limitIdle.stable = limitIdle.rawLast;

  // Startup guard: don't drive straight into a switch that's already
  // triggered (or wired loose). Prefer moving toward home, but reroute
  // toward idle if home is already hit, and refuse to move at all if both
  // are hit -- that combination means a wiring/position fault, not a rail
  // that's simply parked at one end.
  if (limitHome.stable == HIGH && limitIdle.stable == HIGH) {
    motionHalted = true;
    Serial.println("WARNING: both LIMIT_HOME and LIMIT_IDLE read HIGH at boot.");
    Serial.println("Refusing to move -- check wiring and rail position.");
  } else if (limitHome.stable == HIGH) {
    dirState = DIR_TOWARD_IDLE;
    Serial.println("WARNING: LIMIT_HOME already triggered at boot. Starting toward IDLE instead.");
  } else {
    dirState = DIR_TOWARD_HOME;
  }

  digitalWrite(PIN_DIR, dirState);
  digitalWrite(PIN_STEP, LOW);

  // Enable the driver last, once direction/microstep are already set
  digitalWrite(PIN_ENABLE, LOW); // active-LOW: LOW = enabled

  Serial.println();
  Serial.println("=== A4988 NEMA17 bring-up (ESP32-C6, limit-switch endpoints) ===");
  Serial.println("Pins configured as OUTPUT: STEP=8 DIR=14 MS1=1 MS2=18 MS3=6 ENABLE=7");
  Serial.println("Pins configured as INPUT_PULLUP: LIMIT_HOME=20 LIMIT_IDLE=19");
  Serial.println("Heartbeat LED: GPIO15 (onboard LED), toggles every 500 ms");
  Serial.println("Microstepping: 1/8 step (MS1=H, MS2=H, MS3=L)");
  Serial.println("Driver ENABLE: LOW (enabled)");
  Serial.println("Motion: continuous oscillation between LIMIT_HOME and LIMIT_IDLE");
  Serial.print("Cruise speed: ");
  Serial.print(TARGET_REVS_PER_SEC * 60.0f);
  Serial.print(" RPM (");
  Serial.print(TARGET_STEP_HALF_PERIOD_US);
  Serial.println(" us half-period)");
  if (!motionHalted) {
    Serial.print(dirState == DIR_TOWARD_HOME ? "Starting direction: toward HOME" : "Starting direction: toward IDLE");
    Serial.println(dirState == HIGH ? " (DIR pin = HIGH)" : " (DIR pin = LOW)");
  }

  lastToggleMicros = micros();
}

void loop() {
  // Heartbeat: keeps blinking even when motion is halted, so a dead LED means
  // the firmware isn't running (bootloader mode, bad upload, brown-out...).
  unsigned long nowMs = millis();
  if (nowMs - lastHeartbeatMillis >= HEARTBEAT_MS) {
    lastHeartbeatMillis = nowMs;
    heartbeatState = !heartbeatState;
    digitalWrite(PIN_HEARTBEAT, heartbeatState);
  }

  if (motionHalted) {
    return; // both limits were triggered at boot; stay stopped
  }

  bool homeJustTriggered = debouncedTrigger(limitHome);
  bool idleJustTriggered = debouncedTrigger(limitIdle);

  if (dirState == DIR_TOWARD_HOME && homeJustTriggered) {
    // Stop stepping immediately, then reverse toward the opposite end.
    stepPinState = LOW;
    digitalWrite(PIN_STEP, LOW);
    dirState = DIR_TOWARD_IDLE;
    digitalWrite(PIN_DIR, dirState);
    lastToggleMicros = micros(); // full half-period before the next pulse
    Serial.println("LIMIT_HOME hit -> reversing toward IDLE");
  } else if (dirState == DIR_TOWARD_IDLE && idleJustTriggered) {
    stepPinState = LOW;
    digitalWrite(PIN_STEP, LOW);
    dirState = DIR_TOWARD_HOME;
    digitalWrite(PIN_DIR, dirState);
    lastToggleMicros = micros();
    Serial.println("LIMIT_IDLE hit -> reversing toward HOME");
  }

  // Non-blocking square-wave generation on STEP: no delay(), so this loop
  // stays free to grow (position tracking, homing-on-command, etc.) later.
  unsigned long now = micros();
  if (now - lastToggleMicros >= TARGET_STEP_HALF_PERIOD_US) {
    lastToggleMicros = now;
    stepPinState = !stepPinState;
    digitalWrite(PIN_STEP, stepPinState);
  }
}
